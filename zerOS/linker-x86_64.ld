/* TODO: Write a custom bootloader */

/* Tell the linker that we want an x86_64 ELF64 output file */
OUTPUT_FORMAT(elf64-x86-64)
OUTPUT_ARCH(i386:x86-64)

/* We want the symbol _start to be our entry point */
ENTRY(zerOS_boot_setup)

/* Define the program headers we want so the bootloader gives us the right */
/* MMU permissions; this also allows us to exert more control over the linking */
/* process. */
PHDRS
{
    headers PT_PHDR PHDRS;
    text    PT_LOAD FILEHDR PHDRS;
    rodata  PT_LOAD;
    data    PT_LOAD;
    dynamic PT_DYNAMIC;
    /* TODO: Add support for "TLS" or per-cpu variables / sections */
}

SECTIONS
{
    /* We want to be placed in the topmost 2GiB of the address space, for optimisations */
    /* and because that is what the Limine spec mandates. */
    /* Any address in this region will do, but often 0xffffffff80000000 is chosen as */
    /* that is the beginning of the region. */
    /* Additionally, leave space for the ELF headers by adding SIZEOF_HEADERS to the */
    /* base load address. */
    . = 0xffffffff80000000 + SIZEOF_HEADERS;

    /* Emit zerOS_<section_name>_start and zerOS_<section_name>_end symbols for each section. */

    .text : {
        *(.text .text.*)
    } :text

    .bootcode : {
        *(.bootcode .bootcode.*)
    } :text

    /* Move to the next memory page for .rodata */
    . = ALIGN(CONSTANT(MAXPAGESIZE));

    .rodata : {
        *(.rodata .rodata.*)
    } :rodata

    . = ALIGN(CONSTANT(MAXPAGESIZE));

    .zerOS_section_info : {
        
/* --- SECTIONINFO AUTOGENERATED BY /home/axel/Documents/programmation/osdev/zerOS/scripts/gensectioninfo.py, START --- */

/* --- SECTIONINFO START: text --- */
zerOS_text_start = ADDR(.text);
zerOS_text_end = ADDR(.text) + SIZEOF(.text);
zerOS_text_size = SIZEOF(.text);
/* --- SECTIONINFO END: text --- */

/* --- SECTIONINFO START: bootcode --- */
zerOS_bootcode_start = ADDR(.bootcode);
zerOS_bootcode_end = ADDR(.bootcode) + SIZEOF(.bootcode);
zerOS_bootcode_size = SIZEOF(.bootcode);
/* --- SECTIONINFO END: bootcode --- */

/* --- SECTIONINFO START: rodata --- */
zerOS_rodata_start = ADDR(.rodata);
zerOS_rodata_end = ADDR(.rodata) + SIZEOF(.rodata);
zerOS_rodata_size = SIZEOF(.rodata);
/* --- SECTIONINFO END: rodata --- */

/* --- SECTIONINFO START: data --- */
zerOS_data_start = ADDR(.data);
zerOS_data_end = ADDR(.data) + SIZEOF(.data);
zerOS_data_size = SIZEOF(.data);
/* --- SECTIONINFO END: data --- */

/* --- SECTIONINFO START: dynamic --- */
zerOS_dynamic_start = ADDR(.dynamic);
zerOS_dynamic_end = ADDR(.dynamic) + SIZEOF(.dynamic);
zerOS_dynamic_size = SIZEOF(.dynamic);
/* --- SECTIONINFO END: dynamic --- */

/* --- SECTIONINFO START: bss --- */
zerOS_bss_start = ADDR(.bss);
zerOS_bss_end = ADDR(.bss) + SIZEOF(.bss);
zerOS_bss_size = SIZEOF(.bss);
/* --- SECTIONINFO END: bss --- */

/* --- SECTIONINFO AUTOGENERATED BY /home/axel/Documents/programmation/osdev/zerOS/scripts/gensectioninfo.py, END --- */

    } :rodata

    /* Move to the next memory page for .data */
    . = ALIGN(CONSTANT(MAXPAGESIZE));

    .data : {
        *(.data .data.*)

        /* Place the sections that contain the Limine requests as part of the .data */
        /* output section. */
        KEEP(*(.requests_start_marker))
        KEEP(*(.requests))
        KEEP(*(.requests_end_marker))
    } :data

    /* Dynamic section for relocations, both in its own PHDR and inside data PHDR. */
    .dynamic : {
        *(.dynamic)
    } :data :dynamic

    /* NOTE: .bss needs to be the last thing mapped to :data, otherwise lots of */
    /* unnecessary zeros will be written to the binary. */
    /* If you need, for example, .init_array and .fini_array, those should be placed */
    /* above this. */
    .bss : {
        *(.bss .bss.*)
        *(COMMON)
    } :data


    /* Discard .note.* and .eh_frame* since they may cause issues on some hosts. */
    /* Also discard the program interpreter section since we do not need one. This is */
    /* more or less equivalent to the --no-dynamic-linker linker flag, except that it */
    /* works with ld.gold. */
    /DISCARD/ : {
        *(.eh_frame*)
        *(.note .note.*)
        *(.interp)
    }
}